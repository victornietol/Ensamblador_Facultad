;
; circuito1.asm
;
; Created: 06/11/2023 08:37:48 p. m.
; Author : Victor
;


; Replace with your application code
		LDI R18, 0X08
		LDI R19, 0XFF
		OUT SPH, R18
		OUT SPL, R19

		LDI R16, 0XFF
		OUT DDRB, R16
		LDI R17, 0X20 ; ENCENDIDO
		LDI R21, 0X00 ; APAGADO
		LDI R22, 0X00 ; VALOR ANTERIOR

SALIDA:
		CPSE R22, R21
		RJMP ENCENDER
		RJMP APAGAR

ENCENDER:
		LDI R22, 0X00
		OUT PORTB, R17
		RCALL RETARDO
		RCALL RETARDO
		RJMP SALIDA

APAGAR:
		LDI R22, 0X22
		OUT PORTB, R21
		RCALL RETARDO
		RCALL RETARDO
		RJMP SALIDA

RETARDO:
		CLR R0
		CLR R1
		CLR R2
	A:	INC R0
		CPSE R0, R2
		RJMP A
		INC R1
		CPSE R1, R2
		RJMP A
		RET