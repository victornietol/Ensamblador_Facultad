;
; circuito1.asm
;
; Created: 08/11/2023 10:00:12 p. m.
; Author : Victor
;


; Replace with your application code
		.ORG 0X00
		RJMP INICIO
		.ORG 0X12
		RJMP RSI_T2
		.ORG 0X1A 
		RJMP RSI_T1


INICIO:
		; HABILITAR INTERRUPCIONES GLOBALES
		SEI
		
		; STACK POINTER
		LDI R16, 0X08
		LDI R17, 0XFF
		OUT SPH, R16
		OUT SPL, R17

		; CONFIGURACION DE PUERTOS
		OUT DDRB, R17 ; SALIDA PB
		OUT DDRD, R17 ; SALIDA PD
		CLR R25 ; INCREMENTO DE T1 PB
		SER R26 ; INCREMENTO DE T2 PD


		; CONFIGURACION DE T1
		LDI R18, 0X03 ; TCCR1B STS
		LDI R19, 0XF6 ; TCNT1L STS
		LDI R20, 0XC2 ; TCNT1H STS
		LDI R21, 0X01 ; TIMSK1 STS
		LDI R22, 0X00 ; TIFR1  OUT
		STS TCCR1B, R18
		STS TCNT1L, R19
		STS TCNT1H, R20
		STS TIMSK1, R21
		OUT TIFR1, R22

		; CONFIGURACION DE T2 , TIMSK2 Y TIFR2 TIENEN EL MISMO VALOR QUE T1
		LDI R23, 0X07 ; TCCR2B STS
		LDI R24, 0X0B ; TCNT2
		STS TCCR2B, R23
		STS TCNT2, R24
		STS TIMSK2, R21 ; EL MISMO QUE T1
		OUT TIFR2, R22	; EL MISMO QUE T1

FIN:
		RJMP FIN

RSI_T1: 
		INC R25 ; PB
		OUT PORTB, R25
		STS TCNT1L, R19
		STS TCNT1H, R20
		RETI

RSI_T2:
		DEC R26 ; PD
		OUT PORTD, R26
		STS TCNT2, R24
		RETI