;
; circuito6.asm
;
; Created: 28/10/2023 03:22:23 p. m.
; Author : Victor
;


; Replace with your application code
		; INICIALIZAR SP
		;LDI R16, 0X08
		;LDI R17, 0XFF
		;OUT SPH, R16
		;OUT SPL, R17

		; CONFIGURACION PUERTOS
		LDI R18, 0X00 ; PC ENTRADA -> 0000
		OUT DDRC, R18
		LDI R19, 0X0E ; PC PULL UP -> 1110
		OUT PORTC, R19

		LDI R20, 0X7F ; SALIDA PB -> 0111 1111
		OUT DDRB, R20

LECTURA:
		IN R21, PINC ; C
		LDI R23, 0X00 ; A = 0 , PC = 0000 0000
		
		CPSE R23, R21 ; 0
		RJMP UNO ; NO, CONTINUA
		RJMP RES0 ; PC = 0
UNO:	LDI R23, 0X02 ; 1	
		CPSE R23, R21
		RJMP DOS 
		RJMP RES1 ; PC = 1
DOS:	LDI R23, 0X04 ; 2	
		CPSE R23, R21
		RJMP TRES 
		RJMP RES2 ; PC = 2
TRES:	LDI R23, 0X06 ; 3	
		CPSE R23, R21
		RJMP CUATRO 
		RJMP RES3 ; PC = 3
CUATRO:	LDI R23, 0X08 ; 4	
		CPSE R23, R21
		RJMP CINCO 
		RJMP RES4 ; PC = 4
CINCO:	LDI R23, 0X0A ; 5	
		CPSE R23, R21
		RJMP SEIS 
		RJMP RES5 ; PC = 5
SEIS:	LDI R23, 0X0C ; 6	
		CPSE R23, R21
		RJMP SIETE 
		RJMP RES6 ; PC = 6
SIETE:	LDI R23, 0X0E ; 7	
		CPSE R23, R21
		RJMP LECTURA
		RJMP RES7 ; PC = 7

RES0:	LDI R22, 0X7E
		OUT PORTB, R22
		RJMP LECTURA

RES1:	LDI R22, 0X30
		OUT PORTB, R22
		RJMP LECTURA

RES2:	LDI R22, 0X6D
		OUT PORTB, R22
		RJMP LECTURA

RES3:	LDI R22, 0X79
		OUT PORTB, R22
		RJMP LECTURA

RES4:	LDI R22, 0X33
		OUT PORTB, R22
		RJMP LECTURA

RES5:	LDI R22, 0X5B
		OUT PORTB, R22
		RJMP LECTURA

RES6:	LDI R22, 0X1F
		OUT PORTB, R22
		RJMP LECTURA

RES7:	LDI R22, 0X70
		OUT PORTB, R22
		RJMP LECTURA