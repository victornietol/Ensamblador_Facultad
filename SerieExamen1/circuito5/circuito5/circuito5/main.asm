;
; circuito5.asm
;
; Created: 28/10/2023 01:55:32 p. m.
; Author : Victor
;


; Replace with your application code
		.ORG 0X00
		RJMP INICIO
		.ORG 0X02
		RJMP RSI_INT0
		.ORG 0X04
		RJMP RSI_INT1

INICIO: ; INTERRUPCIONES GLOBALES
		SEI

		; INICIALIZAR SP
		LDI R16, 0X08
		LDI R17, 0XFF
		OUT SPH, R16
		OUT SPL, R17

		; CONFIG PUERTOS
		LDI R18, 0XFF
		OUT DDRB, R18  ; PB SALIDA
		CBI DDRD, 2	 ; INT0
		SBI PORTD, 2  ;PULL UP
		CBI DDRD, 3 ; INT1
		SBI PORTD, 3

		; CONFIG INTERRUPCIONES EXTERNAS
		LDI R19, 0X00 ; EIFR
		LDI R20, 0X03 ; EIMSK
		LDI R21, 0X0A ; EICRA
		OUT EIFR, R19
		OUT EIMSK, R20
		STS EICRA, R21

		; VALOR INICIAL

		LDI R22, 0X00 ; B
		OUT PORTB, R22

FIN: RJMP FIN

RSI_INT0:
		LDI R23, 0X00 ; A
		LDI R24, 0X05 ; C
CONTEO:		
		INC R23
		INC R22
		CPSE R23, R24
		RJMP CONTEO
		OUT PORTB, R22
		RETI

RSI_INT1:
		INC R22
		OUT PORTB, R22
		RETI