;
; circuito4.asm
;
; Created: 27/10/2023 05:25:53 a. m.
; Author : Victor
;


; Replace with your application code

		.ORG 0X00
		RJMP INICIO
		.ORG 0X02
		RJMP RSI_INT0

INICIO:
		; HABILITAR INTERRUPCIONES GLOBALES
		SEI

		; INICIALIZAR SP
		LDI R16, 0X08
		LDI R17, 0XFF
		OUT SPH, R16
		OUT SPL, R17

		; CONFIGURACION PUERTOS
		LDI R18, 0X00 ; LECTURA PB
		LDI R19, 0X0F ; PULL UP 0-4
		OUT DDRB, R18
		OUT PORTB, R19

		CBI DDRD, 2 ; ENTRADA INT0 (PD2)
		SBI PORTD, 2 ; PULL UP

		OUT DDRC, R19 ; SALIDA PC 0-4

		; INTERRUPCIONES GLOBALES
		LDI R20, 0X01
		LDI R21, 0X03
		OUT EIMSK, R20
		STS EICRA, R21
		OUT EIFR, R18

REINICIO:		; VALOR INICIAL
		OUT PORTC, R18
		RJMP REINICIO

RSI_INT0:
		IN R22, PINB
		OUT PORTC, R22
		RCALL RETARDO
		RETI

RETARDO:
		CLR R0
		CLR R1
		CLR R2
	A:	INC R0
		CPSE R0, R2
		RJMP A
		INC R1
		CPSE R1, R2
		RJMP A
		RET