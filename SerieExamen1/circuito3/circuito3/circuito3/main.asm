;
; circuito3.asm
;
; Created: 27/10/2023 03:38:32 a. m.
; Author : Victor
;


; Replace with your application code
		; INICIALIZAR SP
		LDI R16, 0X08
		LDI R17, 0XFF
		OUT SPH, R16
		OUT SPL, R17

		; CONFIGURACION DE PUERTOS
		LDI R18, 0XFF ; SALIDA PB
		OUT DDRB, R18
		CBI DDRC, 0  ; ENTRADA PC0
		SBI PORTC, 0

		; VALOR INICIAL
		LDI R19, 0X00 ; VALOR DE PB
		OUT PORTB, R19

		; CUENTA
CUENTA: 
		RCALL RETARDO ; RETARDO 250
		SBIS PINC, 0 ; PC0==1
		RJMP INCREMENTAR ; NO
		RCALL RETARDO ; SI, RETARDO 500
		RJMP INCREMENTAR

RETARDO:
		CLR R0
		CLR R1
		CLR R2
	A:	INC R0
		CPSE R0, R2
		RJMP A
		INC R1
		CPSE R1, R2
		RJMP A
		RET

INCREMENTAR:  ; SUMA Y MUESTRA RESULTADO
		INC R19
		OUT PORTB, R19
		RJMP CUENTA