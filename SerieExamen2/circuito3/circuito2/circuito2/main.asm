;
; circuito2.asm
;
; Created: 27/11/2023 02:43:55 p. m.
; Author : Victor
;


; Replace with your application code
		.ORG 0X00
		RJMP INICIO
		.ORG 0X20
		RJMP RSI_T0
		.ORG 0X2A
		RJMP RSI_ADC

INICIO:
		; HABILITAR I.G.
		SEI 

		; INICIALIZAR SP
		LDI R16, 0X08
		LDI R17, 0XFF
		OUT SPH, R16
		OUT SPL, R17

		; CONFIGURACION PUERTOS
		OUT DDRB, R17 ; SALIDA PB 

		; CONFIGURACION DE T0
		CLR R18 ; TIFR0 0000 0000  DESBORDAMIENTO DESDE 0
		LDI R19, 0X01 ; TIMSK0 0000 0001
		; TCNT0 0000 0000  -> USAR R18 (INICIO DEL REGISTRO)
		LDI R20, 0X05 ; TCCR0B 0000 0101
		OUT TIFR0, R18
		STS TIMSK0, R19
		;LDI R25, 0XEF ; TCNT0 -> DESBORDAMIENTO CASI INSTANTANEO 
		OUT TCNT0, R18
		OUT TCCR0B, R20

		; CONFIGURACION ADC
		LDI R21, 0X25 ; ADMUX 0010 0101 -> 0X25
		LDI R22, 0XE8 ; ADCSRA 1110 1000 -> 0XE8
		LDI R23, 0X04 ; ADCSRB 0000 0100 -> 0X04
		STS ADMUX, R21
		STS ADCSRA, R22
		STS ADCSRB, R23

FIN:
		RJMP FIN

RSI_T0:
		OUT PORTB, R24 ; MOSTRAR RESULTADO DE DIGITALIZACION
		OUT TCNT0, R18 ; EMPIEZA A CONTAR DE NUEVO
		RETI

RSI_ADC:
		LDS R24, ADCH ; LEER VALOR DE LA DIGITALIZACION
		RETI