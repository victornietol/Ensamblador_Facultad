;
; circuito4.asm
;
; Created: 27/11/2023 05:42:20 p. m.
; Author : Victor
;


; Replace with your application code
		.ORG 0X00
		RJMP INICIO
		.ORG 0X02
		RJMP RSI_INT0
		.ORG 0X04
		RJMP RSI_INT1

INICIO:
		; HABILITAR I.G.
		SEI

		; INICIALIZAR SP
		LDI R16, 0X08
		LDI R17, 0XFF
		OUT SPH, R16
		OUT SPL, R17

		; CONFIGURACION PUERTOS
		SBI DDRB, 3 ; SALIDA PB3 
		CBI DDRD, 2 ; ENTRADA PD2
		CBI DDRD, 3 ; ENTRADA PD3
		SBI PORTD, 2 ; PULL UP PD2
		SBI PORTD, 3 ; PULL UP PD3

		; CONFIGURACION INTERRUPCIONES EXTERNAS
		LDI R21, 0X00 ; EIFR 0X00
		LDI R22, 0X03 ; EIMSK 0X03
		LDI R23, 0X0F ; EICRA 0000 1111 -> 0X0F
		OUT EIFR, R21
		OUT EIMSK, R22
		STS EICRA, R23

		; CONFIGURACION T2
		LDI R18, 0X83 ; TCCR2A 1000 0011 -> 0X83
		LDI R19, 0X02 ; TCCR2B 0000 0010 -> 0X02
		LDI R20, 0X7F ; OCR2A 255=100% -> 0XFF - 127=50% -> 0X7F 
		STS TCCR2A, R18
		STS TCCR2B, R19
		STS OCR2A, R20

FIN:	RJMP FIN

RSI_INT0:
		LDI R20, 0X40 ; OCR2A 64=25% -> 0X40
		STS OCR2A, R20
		RETI

RSI_INT1:
		LDI R20, 0XBF ; OCR2A 191=75% -> 0XBF
		STS OCR2A, R20
		RETI