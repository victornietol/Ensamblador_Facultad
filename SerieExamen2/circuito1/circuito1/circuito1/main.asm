;
; circuito1.asm
;
; Created: 27/11/2023 12:59:04 a. m.
; Author : Victor
;


; Replace with your application code
		.ORG 0X00
		RJMP INICIO
		.ORG 0X2A
		RJMP RSI_ADC

INICIO:
		; HABILITAR I.G.
		SEI

		; INICIALIZAR SP
		LDI R16, 0X08
		LDI R17, 0XFF
		OUT SPH, R16
		OUT SPL, R17
		
		; CONFIGURACION DE PUERTOS
		SBI DDRD, 6 ; SALIDA PD6, CORRSPONDE AL CANAL A DEL T0

		; CONFIGURACION DE T0
		LDI R18, 0X83 ; TCCR0A 1000 0011 -> 0X83
		LDI R19, 0X02 ; TCCR0B 0000 0010 -> 0X02
		OUT TCCR0A, R18
		OUT TCCR0B, R19
		; OCR0A INDICADO POR EL CANAL 0 DEL ADC

		; CONFIGURACION DEL ADC (CANAL 0)
		LDI R20, 0X20; ADMUX 0010 0000 -> 0X20
		LDI R21, 0XE8; ADCSRA 1110 1000 -> 0XE8
		CLR R22 ; ADCSRB 0000 0000 -> 0X00
		STS ADMUX, R20
		STS ADCSRA, R21
		STS ADCSRB, R22

FIN: 
		RJMP FIN

RSI_ADC:
		LDS R23, ADCH ; LECTURA DE LA DIGITALIZACION
		OUT OCR0A, R23 ; CAMBIAR VALOR DEL OCR0A (CICLO DE TRABAJO DEL PWM)
		RETI