;
; circuito1.asm
;
; Created: 23/11/2023 05:06:00 p. m.
; Author : Victor
;


; Replace with your application code
		.ORG 0X00
		RJMP INICIO
		.ORG 0X2A
		RJMP RSI_ADC

INICIO: 
		SEI

		;STACK POINTER
		LDI R16, 0X08
		LDI R17, 0XFF
		OUT SPH, R16
		OUT SPL, R17

		; CONFIGURACION PUERTOS
		OUT DDRD, R17 ; SALIDA PB
		OUT DDRB, R17 ; SALIDA PD

		; CONFIGURACION ADC
		LDI R18, 0X20 ; ADMUX CANAL 0
		LDI R19, 0X25 ; ADMUX CANAL 5
		LDI R20, 0XE8 ; ADCSRA
		CLR R21		  ; ADCSRB
		STS ADMUX, R18
		STS ADCSRA, R20
		STS ADCSRB, R21
FIN: 
		RJMP FIN

RSI_ADC:
		LDS R23, ADMUX ; LECTURA DEL ADMUX
		CPSE R18, R23  ; VERIFICAR EN QUE VALOR ESTA EL ADMUX
		RJMP CANAL5 ;NO
		RJMP CANAL0 ;SI 
CANAL5:
		LDS R22, ADCH ; LECTURA DEL REGISTRO MEMORY MAPPED (SE USA LDS EN LUGAR DE IN)
		OUT PORTD, R22
		STS ADMUX, R18
		RETI
CANAL0:
		LDS R22, ADCH
		OUT PORTB, R22
		STS ADMUX, R19
		RETI